## CMakeLists.txt
```
# SPDX-License-Identifier: Apache-2.0

cmake_minimum_required(VERSION 3.20.0)

find_package(Zephyr REQUIRED HINTS $ENV{ZEPHYR_BASE})
project(blynk_mqtt_ota)

# Add your include directory for headers
zephyr_include_directories(include)

# Add your app source files
target_sources(app PRIVATE
    src/main.c
    src/mqtt_client.c
    src/ota_manager.c
    src/utils.c
    src/network_manager.c
)
```

## Kconfig
```
# Private config options for mqtt-blynk sample app

# Copyright (c) Blynk Inc
# SPDX-License-Identifier: Apache-2.0

mainmenu "Networking mqtt-blynk sample application"

config CLOUD_BLYNK_AUTH_TOKEN
	string "Blynk cloud auth token"
	help
	  Auth token of your Blynk device.

config CLOUD_BLYNK_TEMPLATE_ID
    string "Blynk Template ID"
    help
        Product's Template ID is used to check if new Device is allowed to work with the Product's settings

config CLOUD_BLYNK_FIRMWARE_TYPE
	string "Blynk Firmware type"
    default CLOUD_BLYNK_TEMPLATE_ID
	help
	  Firmware type (usually same as Template ID)

config CLOUD_BLYNK_TEMPLATE_NAME
    string "Blynk Template Name"
    help
        Specify your Template Name here

config CLOUD_BLYNK_FIRMWARE_VERSION
    string "Firmware version"
    default MCUBOOT_IMGTOOL_SIGN_VERSION
    help
        Used for OTA purposes

config CLOUD_BLYNK_SERVER_ADDR
	string "Blynk cloud server address"
	default "blynk.cloud"
	help
	  Blynk cloud server address.

config CLOUD_BLYNK_SERVER_PORT
	int "Blynk cloud server port number"
	default 8883
	help
	  Blynk cloud server port number.

source "Kconfig.zephyr"
```

## sample.yaml
```
common:
  filter: CONFIG_FULL_LIBC_SUPPORTED
sample:
  description: MQTT sample app to Blynk cloud
  name: mqtt-blynk
tests:
  sample.net.cloud.mqtt_blynk:
    harness: net
    platform_allow:
      - sam_e70_xplained/same70q21
      - frdm_k64f
      - qemu_x86
    integration_platforms:
      - qemu_x86
    tags:
      - net
      - mqtt
      - cloud
```

## sysbuild.conf
```
# Enable MCUboot per default for this sample.
SB_CONFIG_BOOTLOADER_MCUBOOT=y
SB_CONFIG_MCUBOOT_MODE_SWAP_SCRATCH=y
```

## prj.conf
```kconfig
# ----------------------------------------
# Networking Configuration
# ----------------------------------------
# FIXME: move STM32_** to overlay
CONFIG_NETWORKING=y
CONFIG_NET_IPV4=y
CONFIG_NET_TCP=y
CONFIG_NET_UDP=y
CONFIG_NET_DHCPV4=y
CONFIG_NET_SOCKETS=y
CONFIG_NET_SOCKETS_SOCKOPT_TLS=y
CONFIG_NET_SOCKETS_POLL_MAX=10
CONFIG_NET_SOCKETS_TLS_MAX_CONTEXTS=3
CONFIG_NET_IF_MAX_IPV4_COUNT=2
CONFIG_NET_IF_UNICAST_IPV4_ADDR_COUNT=3
CONFIG_NET_CONFIG_SETTINGS=y
CONFIG_NET_CONFIG_AUTO_INIT=y
CONFIG_NET_CONFIG_NEED_IPV4=y
CONFIG_NET_CONFIG_MY_IPV4_ADDR=""
CONFIG_NET_CONFIG_MY_IPV4_NETMASK=""
CONFIG_NET_CONFIG_MY_IPV4_GW=""
CONFIG_NET_CONNECTION_MANAGER=y
CONFIG_NET_MGMT_EVENT_STACK_SIZE=1024
CONFIG_NET_MGMT_EVENT_QUEUE_SIZE=5
CONFIG_NET_CONTEXT_NET_PKT_POOL=y
CONFIG_NET_MAX_CONTEXTS=10
CONFIG_NET_PKT_RX_COUNT=64
CONFIG_NET_PKT_TX_COUNT=32
CONFIG_NET_BUF_RX_COUNT=64
CONFIG_NET_BUF_TX_COUNT=64
CONFIG_NET_BUF_DATA_SIZE=1536
CONFIG_ETH_STM32_HAL=y
CONFIG_ETH_STM32_HAL_RX_THREAD_STACK_SIZE=2048
CONFIG_ETH_STM32_HAL_RX_THREAD_PRIO=1
CONFIG_DNS_RESOLVER=y
CONFIG_DNS_SERVER_IP_ADDRESSES=y
CONFIG_DNS_SERVER1="8.8.8.8"
CONFIG_DNS_RESOLVER_ADDITIONAL_BUF_CTR=2

# ----------------------------------------
# MQTT Configuration
# ----------------------------------------
CONFIG_MQTT_LIB=y
CONFIG_MQTT_LIB_TLS=y

# ----------------------------------------
# TLS/SSL Configuration
# ----------------------------------------
CONFIG_TLS_CREDENTIALS=y
CONFIG_TLS_MAX_CREDENTIALS_NUMBER=6
CONFIG_MBEDTLS=y
CONFIG_MBEDTLS_BUILTIN=y
CONFIG_MBEDTLS_ENABLE_HEAP=y
CONFIG_MBEDTLS_HEAP_SIZE=100000
CONFIG_MBEDTLS_SSL_MAX_CONTENT_LEN=16384
CONFIG_MBEDTLS_PEM_CERTIFICATE_FORMAT=y
CONFIG_MBEDTLS_SHA1=y
CONFIG_MBEDTLS_SHA384=y
CONFIG_MBEDTLS_MD=y
CONFIG_MBEDTLS_KEY_EXCHANGE_ECDHE_RSA_ENABLED=y
CONFIG_MBEDTLS_ECP_DP_SECP256R1_ENABLED=y
CONFIG_MBEDTLS_ECDH_C=y
CONFIG_MBEDTLS_ECP_C=y

# ----------------------------------------
# Blynk OTA: Add crypto support for checksum verification
# ----------------------------------------
CONFIG_MBEDTLS_MD5=y
CONFIG_MBEDTLS_SHA256=y
CONFIG_MBEDTLS_CIPHER=y

# ----------------------------------------
# Blynk OTA: Add CRC support for additional verification
# ----------------------------------------
CONFIG_CRC=y

# ----------------------------------------
# HTTP Client and JSON Support
# ----------------------------------------
CONFIG_HTTP_CLIENT=y
CONFIG_HTTP_PARSER=y
CONFIG_HTTP_PARSER_URL=y
CONFIG_JSON_LIBRARY=y

# ----------------------------------------
# Flash and Image Management
# ----------------------------------------
CONFIG_FLASH=y
CONFIG_SOC_FLASH_STM32=y
CONFIG_FLASH_PAGE_LAYOUT=y
CONFIG_FLASH_MAP=y
CONFIG_STREAM_FLASH=y
CONFIG_IMG_MANAGER=y
CONFIG_IMG_ENABLE_IMAGE_CHECK=y
CONFIG_IMG_MANAGER_LOG_LEVEL_DBG=y
CONFIG_MCUBOOT_IMG_MANAGER=y
CONFIG_BOOTLOADER_MCUBOOT=y
CONFIG_MCUBOOT_BOOTUTIL_LIB=y
CONFIG_MCUBOOT_SIGNATURE_KEY_FILE="bootloader/mcuboot/root-rsa-2048.pem"
CONFIG_MCUBOOT_GENERATE_CONFIRMED_IMAGE=y
CONFIG_MCUBOOT_IMGTOOL_SIGN_VERSION="1.1.7"
CONFIG_MCUBOOT_BOOTLOADER_MODE_SWAP_SCRATCH=y
CONFIG_USE_DT_CODE_PARTITION=y
CONFIG_MPU_ALLOW_FLASH_WRITE=y

# ----------------------------------------
# System Settings
# ----------------------------------------
CONFIG_POSIX_API=y
CONFIG_REQUIRES_FULL_LIBC=y
CONFIG_NEWLIB_LIBC=y
CONFIG_INIT_STACKS=y
CONFIG_STACK_CANARIES=y
CONFIG_REBOOT=y

# ----------------------------------------
# Thread and Stack Configuration
# ----------------------------------------
CONFIG_THREAD_NAME=y
CONFIG_THREAD_MONITOR=y
CONFIG_MAIN_STACK_SIZE=8192
CONFIG_SYSTEM_WORKQUEUE_STACK_SIZE=8192
CONFIG_NET_RX_STACK_SIZE=4096
CONFIG_NET_TX_STACK_SIZE=4096
CONFIG_HEAP_MEM_POOL_SIZE=2048

# ----------------------------------------
# Logging Configuration
# ----------------------------------------
#CONFIG_LOG_MODE_DEFERRED=y
CONFIG_LOG_MODE_IMMEDIATE=y
CONFIG_NET_LOG=y
CONFIG_NET_SHELL=y
CONFIG_MQTT_LOG_LEVEL_INF=y

# Disable verbose logging
CONFIG_NET_TCP_LOG_LEVEL_DBG=n
CONFIG_NET_SOCKETS_LOG_LEVEL_DBG=n
CONFIG_NET_DHCPV4_LOG_LEVEL_INF=n
CONFIG_NET_IF_LOG_LEVEL_DBG=n
CONFIG_SOCKS_LOG_LEVEL_DBG=n
CONFIG_NET_CONFIG_LOG_LEVEL_DBG=n
CONFIG_NET_CONNECTION_MANAGER_LOG_LEVEL_DBG=n
CONFIG_DNS_RESOLVER_LOG_LEVEL_DBG=n
CONFIG_NET_CONTEXT_LOG_LEVEL_DBG=n
CONFIG_MBEDTLS_DEBUG=n

# ----------------------------------------
# Disabled Features
# ----------------------------------------
CONFIG_NET_IPV6=n
CONFIG_SOCKS=n

# ----------------------------------------
# Blynk OTA: Additional requirements for floating point math
# ----------------------------------------
CONFIG_NEWLIB_LIBC_FLOAT_PRINTF=y
CONFIG_NEWLIB_LIBC_FLOAT_SCANF=y
```

## src/main.c
```c
/*
 * SPDX-FileCopyrightText: 2025 Khrystyna Olkhovetska for Blynk Technologies Inc.
 * SPDX-License-Identifier: Apache-2.0
 */

#include <zephyr/logging/log.h>
LOG_MODULE_REGISTER(mqtt_blynk, LOG_LEVEL_INF);

#include <zephyr/kernel.h>
#include <zephyr/dfu/mcuboot.h>
#include <zephyr/net/socket.h>
#include <zephyr/sys/reboot.h>
#include <zephyr/random/random.h>
#include <string.h>
#include <math.h>
#include <stdio.h>

#include "root_certificates.h"
#include "mqtt_client.h"
#include "network_manager.h"
#include "ota_manager.h"
#include "utils.h"

BUILD_ASSERT(1 != sizeof(CONFIG_CLOUD_BLYNK_FIRMWARE_VERSION), "CONFIG_CLOUD_BLYNK_FIRMWARE_VERSION is required");
BUILD_ASSERT(1 != sizeof(CONFIG_CLOUD_BLYNK_TEMPLATE_NAME), "CONFIG_CLOUD_BLYNK_TEMPLATE_NAME is required");
BUILD_ASSERT(1 != sizeof(CONFIG_CLOUD_BLYNK_AUTH_TOKEN), "CONFIG_CLOUD_BLYNK_AUTH_TOKEN is required");
BUILD_ASSERT(1 != sizeof(CONFIG_CLOUD_BLYNK_TEMPLATE_ID), "CONFIG_CLOUD_BLYNK_TEMPLATE_ID is required");

bool power_on       = false;
float target_temp   = 23.0f;
float current_temp  = 15.0f;

/* Work items for periodic tasks */
static struct k_work_delayable device_update_work;

/* Function to get random publish interval */
static int get_random_publish_interval(void)
{
    return 10 + (sys_rand8_get() % 5); // 10-15 seconds
}

/* Publish firmware and device info message for Blynk OTA */
static void publish_firmware_info(void)
{
    char info_payload[512];

    /* Construct firmware info JSON matching Blynk specification */
    snprintf(info_payload, sizeof(info_payload),
        "{"
            "\"tmpl\":\"%s\","
            "\"ver\":\"%s\","
            "\"fw-type\":\"%s\","
            "\"build\":\"%s\","
            "\"blynk\":\"1.3.0\","
            "\"board\":\"%s\","
            "\"conn\":\"WiFi\","
            "\"rxbuff\":%d"
        "}",
        CONFIG_CLOUD_BLYNK_TEMPLATE_NAME,
        CONFIG_CLOUD_BLYNK_FIRMWARE_VERSION,
        CONFIG_CLOUD_BLYNK_FIRMWARE_TYPE,
        __DATE__ " " __TIME__,
        CONFIG_BOARD,
        APP_MQTT_BUFFER_SIZE
    );

    /* Publish to info/mcu topic - this is critical for Blynk OTA */
    publish_str("info/mcu", info_payload);

    LOG_INF("Published firmware info: type=%s, ver=%s",
            CONFIG_CLOUD_BLYNK_FIRMWARE_TYPE, CONFIG_CLOUD_BLYNK_FIRMWARE_VERSION);
}

/* Device simulation and business logic */
static void update_device_simulation(void)
{
    float target = power_on ? target_temp : 10.0f;

    /* Simulate temperature change */
    current_temp += (target - current_temp) * 0.05f;
    current_temp += ((0.5f - ((float)(sys_rand32_get() % 1000) / 1000.0f)) * 0.3f);
    current_temp = fminf(fmaxf(current_temp, 10.0f), 35.0f);

    /* Publish temperature */
    char temp_str[16];
    snprintf(temp_str, sizeof(temp_str), "%.2f", (double)current_temp);
    publish_str("ds/Current Temperature", temp_str);

    /* Calculate and publish state */
    int state = 1;  /* Off */
    if (power_on) {
        if (fabsf(current_temp - target_temp) < 1.0f) {
            state = 2;  /* At temperature */
        } else if (target_temp > current_temp) {
            state = 3;  /* Heating */
        } else {
            state = 4;  /* Cooling */
        }
    }

    /* State colors */
    const char *colors[] = { NULL, "E4F6F7", "E6F7E4", "F7EAE4", "E4EDF7" };

    char state_str[8];
    snprintf(state_str, sizeof(state_str), "%d", state);
    publish_str("ds/Status", state_str);

    if (colors[state]) {
        publish_str("ds/Status/prop/color", colors[state]);
    }
}

static void device_update_work_handler(struct k_work *work)
{
    update_device_simulation();
    k_work_reschedule(&device_update_work, K_SECONDS(get_random_publish_interval()));
}

static void handle_terminal_command(const char *payload)
{
    char cmd_buf[64];
    strncpy(cmd_buf, payload, sizeof(cmd_buf) - 1);
    cmd_buf[sizeof(cmd_buf) - 1] = '\0';

    char *cmd = strtok(cmd_buf, " \r\n");
    if (!cmd) {
        return;
    }

    if (strcmp(cmd, "set") == 0) {
        char *arg = strtok(NULL, " \r\n");
        if (arg) {
            target_temp = atof(arg);
            terminal_print("Temperature set");

            char val[16];
            snprintf(val, sizeof(val), "%.1f", (double)target_temp);
            publish_str("ds/Set Temperature", val);
        }
    } else if (strcmp(cmd, "on") == 0) {
        power_on = true;
        publish_str("ds/Power", "1");
        terminal_print("Turned ON");
    } else if (strcmp(cmd, "off") == 0) {
        power_on = false;
        publish_str("ds/Power", "0");
        terminal_print("Turned OFF");
    } else if (strcmp(cmd, "info") == 0) {
        /* Republish firmware info for testing */
        publish_firmware_info();
        terminal_print("Firmware info published");
    } else if (strcmp(cmd, "ota") == 0) {
        /* Test OTA with example payload */
        const char *test_ota =
            "{"
            "\"url\":\"https://blynk.cloud/static/test.bin?token=example\","
            "\"size\":32768,"
            "\"type\":\"" CONFIG_CLOUD_BLYNK_FIRMWARE_TYPE "\","
            "\"ver\":\"1.0.1\","
            "\"build\":\"Test Build\","
            "\"md5\":\"2F173423615FE972834523192623DF62\""
            "}";
        terminal_print("Testing OTA with MD5 verification...");
        parse_ota_json_and_start(test_ota, strlen(test_ota));
    } else if ((strcmp(cmd, "help") == 0) || (strcmp(cmd, "?") == 0)) {
        terminal_print("Available commands:");
        terminal_print("  set N    - set target temperature");
        terminal_print("  on       - turn on");
        terminal_print("  off      - turn off");
        terminal_print("  info     - republish firmware info");
        terminal_print("  ota      - test OTA (demo)");
    } else {
        terminal_print("Unknown command");
    }
}

void handle_incoming_topic(const char *topic, const char *payload)
{
    LOG_INF("Received: %s -> %s", topic, payload);

    if (strcmp(topic, "downlink/ds/Power") == 0) {
        power_on = atoi(payload);
        publish_str("ds/Set Temperature/prop/isDisabled", power_on ? "0" : "1");
        update_device_simulation();
    } else if (strcmp(topic, "downlink/ds/Set Temperature") == 0) {
        target_temp = atof(payload);
        update_device_simulation();
    } else if (strcmp(topic, "downlink/ds/Terminal") == 0) {
        handle_terminal_command(payload);
        update_device_simulation();
    } else if (strcmp(topic, "downlink/reboot") == 0) {
        LOG_INF("Reboot requested");
        terminal_print("Rebooting...");
        k_sleep(K_SECONDS(1));
        sys_reboot(SYS_REBOOT_COLD);
    } else if (strcmp(topic, "downlink/redirect") == 0) {
        char new_host[128];
        uint16_t new_port;
        if (parse_url(payload, new_host, sizeof(new_host), &new_port)) {
            strncpy(broker_host, new_host, sizeof(broker_host) - 1);
            broker_port = new_port;
            LOG_INF("Redirecting to: %s:%d", broker_host, broker_port);

            abort_mqtt_connection();
            k_sem_give(&mqtt_start);
        } else {
            LOG_ERR("Failed to parse redirect URL: %s", payload);
        }
    } else if (strcmp(topic, "downlink/ota/json") == 0) {
        /* This is the official Blynk OTA notification topic */
        if (blynk_ota_ctx.in_progress) {
            LOG_WRN("OTA already in progress");
            terminal_print("OTA already in progress");
            return;
        }

        LOG_INF("Received Blynk OTA notification");
        terminal_print("Received OTA notification...");

        /* Process the OTA notification according to Blynk specification */
        int ret = parse_ota_json_and_start(payload, strlen(payload));
        if (ret) {
            LOG_ERR("Failed to process OTA notification: %d", ret);
            terminal_print("OTA notification processing failed");
        }
    } else if (strcmp(topic, "downlink/ping") == 0) {
        LOG_DBG("Ping received");
    }
}

/* MQTT connection established callback */
void on_mqtt_connected(void)
{
    /* Send welcome message */
    terminal_print("      ___  __          __");
    terminal_print("     / _ )/ /_ _____  / /__");
    terminal_print("    / _  / / // / _ \\ /  '_/");
    terminal_print("   /____/_/\\_, /_//_/_/\\_\\");
    terminal_print("          /___/");
    terminal_print("Type \"help\" for the list of available commands");

    /* Publish firmware and device info - this is critical for Blynk OTA */
    publish_firmware_info();
}

/* MQTT subscription successful callback */
void on_mqtt_subscribed(void)
{
    publish_str("get/ds", "Power,Set Temperature");

    /* Start periodic device updates */
    k_work_reschedule(&device_update_work, K_SECONDS(get_random_publish_interval()));
}

/* MQTT disconnected callback */
void on_mqtt_disconnected(void)
{
    /* Stop periodic updates */
    k_work_cancel_delayable(&device_update_work);
}

int tls_init(void)
{
    int err = tls_credential_add(APP_CA_CERT_TAG,
                                TLS_CREDENTIAL_CA_CERTIFICATE,
                                ca_certificate,
                                sizeof(ca_certificate));
    if (err < 0) {
        LOG_ERR("Failed to register public certificate: %d", err);
        return err;
    }
    return 0;
}

int main(void)
{
    int rc;

    LOG_INF("Firmware version: %s", CONFIG_CLOUD_BLYNK_FIRMWARE_VERSION);

    /* Initialize work items */
    k_work_init_delayable(&device_update_work, device_update_work_handler);

    /* Confirm boot image - CRITICAL for OTA */
    if (boot_is_img_confirmed() == 0) {
        int ret = boot_write_img_confirmed();
        if (ret == 0) {
            LOG_INF("Image confirmed successfully");
        } else {
            LOG_ERR("Failed to confirm image: %d", ret);
        }
    } else {
        LOG_INF("Image already confirmed");
    }

    /* Check configuration */
    if (strlen(CONFIG_CLOUD_BLYNK_AUTH_TOKEN) == 0) {
        LOG_ERR("Blynk auth token is empty. Check your configuration.");
        return -EINVAL;
    }

    /* Initialize TLS */
    rc = tls_init();
    if (rc) {
        return rc;
    }

    /* Initialize network manager */
    network_manager_init();

    /* Main loop */
    while (1) {
        k_sem_take(&mqtt_start, K_FOREVER);
        connect_to_cloud_and_publish();
    }

    return 0;
}
```

## include/mqtt_client.h
```c
#ifndef MQTT_CLIENT_H_
#define MQTT_CLIENT_H_

#include <zephyr/net/mqtt.h>
#include <zephyr/kernel.h>
#include <zephyr/net/net_mgmt.h>
#include <stdbool.h>

/* Constants */
#define APP_CA_CERT_TAG         1
#define APP_MQTT_BUFFER_SIZE   1024

/* Global variables for MQTT connection state */
extern struct net_mgmt_event_callback l4_mgmt_cb;
extern const uint32_t L4_EVENT_MASK;
extern struct mqtt_client client_ctx;
extern bool mqtt_connected;
extern struct k_sem mqtt_start;

/* Broker configuration */
extern char broker_host[128];
extern uint16_t broker_port;

/* Core MQTT functions - communication only */
void connect_to_cloud_and_publish(void);
void publish_str(const char *topic, const char *value);
void terminal_print(const char *msg);
void abort_mqtt_connection(void);

/* Internal MQTT functions */
void client_init(struct mqtt_client *client);

/* Business logic callbacks - implemented in main.c */
extern void handle_incoming_topic(const char *topic, const char *payload);
extern void on_mqtt_connected(void);
extern void on_mqtt_subscribed(void);
extern void on_mqtt_disconnected(void);

#endif /* MQTT_CLIENT_H_ */
```

## include/network_manager.h
```c
#ifndef NETWORK_MANAGER_H_
#define NETWORK_MANAGER_H_

#include <zephyr/kernel.h>
#include <zephyr/net/net_if.h>
#include <zephyr/net/net_mgmt.h>

void network_manager_init(void);
bool is_network_connected(void);

#if defined(CONFIG_NET_DHCPV4)
void check_network_connection(struct k_work *work);
void l4_event_handler(struct net_mgmt_event_callback *cb, uint32_t mgmt_event, struct net_if *iface);
#endif

#endif /* NETWORK_MANAGER_H_ */
```

## include/ota_manager.h
```c
#ifndef OTA_MANAGER_H_
#define OTA_MANAGER_H_

#include <stdint.h>
#include <stdbool.h>
#include <stddef.h>
#include <zephyr/net/http/client.h>

#define APP_CA_CERT_TAG 1

struct ota_context {
    bool in_progress;
    uint32_t size;
    uint32_t downloaded;
    char url[256];
    char version[32];
    char host[128];
    char path[512];
    uint16_t port;
    bool use_tls;
};

extern struct ota_context blynk_ota_ctx;

/* Main OTA functions */
int parse_ota_json_and_start(const char *json_data, size_t json_len);

/* HTTP response callback for OTA */
void ota_http_response_cb(struct http_response *rsp, enum http_final_call final_data, void *user_data);

/* MCUboot functions - make sure these are declared */
extern int boot_set_pending_multi(int image_index, int permanent);
extern bool boot_is_img_confirmed(void);
extern int boot_write_img_confirmed(void);

#endif // OTA_MANAGER_H_
```

## include/root_certificates.h
```c
/*
 * SPDX-FileCopyrightText: 2024 Volodymyr Shymanskyy for Blynk Technologies Inc.
 * SPDX-License-Identifier: Apache-2.0
 *
 * 4096 bit, ISRG Root X1,            expires: Mon, 04 Jun 2035 11:04:38 GMT
 * 2048 bit, Amazon Root CA 1,        expires: Sun, 17 Jan 2038 00:00:00 GMT
 * 2048 bit, DigiCert Global Root G2, expires: Fri, 15 Jan 2038 12:00:00 GMT
 */
static const unsigned char ca_certificate[] = {
"-----BEGIN CERTIFICATE-----\r\n"
"MIIFazCCA1OgAwIBAgIRAIIQz7DSQONZRGPgu2OCiwAwDQYJKoZIhvcNAQELBQAw\r\n"
"TzELMAkGA1UEBhMCVVMxKTAnBgNVBAoTIEludGVybmV0IFNlY3VyaXR5IFJlc2Vh\r\n"
"cmNoIEdyb3VwMRUwEwYDVQQDEwxJU1JHIFJvb3QgWDEwHhcNMTUwNjA0MTEwNDM4\r\n"
"WhcNMzUwNjA0MTEwNDM4WjBPMQswCQYDVQQGEwJVUzEpMCcGA1UEChMgSW50ZXJu\r\n"
"ZXQgU2VjdXJpdHkgUmVzZWFyY2ggR3JvdXAxFTATBgNVBAMTDElTUkcgUm9vdCBY\r\n"
"MTCCAiIwDQYJKoZIhvcNAQEBBQADggIPADCCAgoCggIBAK3oJHP0FDfzm54rVygc\r\n"
"h77ct984kIxuPOZXoHj3dcKi/vVqbvYATyjb3miGbESTtrFj/RQSa78f0uoxmyF+\r\n"
"0TM8ukj13Xnfs7j/EvEhmkvBioZxaUpmZmyPfjxwv60pIgbz5MDmgK7iS4+3mX6U\r\n"
"A5/TR5d8mUgjU+g4rk8Kb4Mu0UlXjIB0ttov0DiNewNwIRt18jA8+o+u3dpjq+sW\r\n"
"T8KOEUt+zwvo/7V3LvSye0rgTBIlDHCNAymg4VMk7BPZ7hm/ELNKjD+Jo2FR3qyH\r\n"
"B5T0Y3HsLuJvW5iB4YlcNHlsdu87kGJ55tukmi8mxdAQ4Q7e2RCOFvu396j3x+UC\r\n"
"B5iPNgiV5+I3lg02dZ77DnKxHZu8A/lJBdiB3QW0KtZB6awBdpUKD9jf1b0SHzUv\r\n"
"KBds0pjBqAlkd25HN7rOrFleaJ1/ctaJxQZBKT5ZPt0m9STJEadao0xAH0ahmbWn\r\n"
"OlFuhjuefXKnEgV4We0+UXgVCwOPjdAvBbI+e0ocS3MFEvzG6uBQE3xDk3SzynTn\r\n"
"jh8BCNAw1FtxNrQHusEwMFxIt4I7mKZ9YIqioymCzLq9gwQbooMDQaHWBfEbwrbw\r\n"
"qHyGO0aoSCqI3Haadr8faqU9GY/rOPNk3sgrDQoo//fb4hVC1CLQJ13hef4Y53CI\r\n"
"rU7m2Ys6xt0nUW7/vGT1M0NPAgMBAAGjQjBAMA4GA1UdDwEB/wQEAwIBBjAPBgNV\r\n"
"HRMBAf8EBTADAQH/MB0GA1UdDgQWBBR5tFnme7bl5AFzgAiIyBpY9umbbjANBgkq\r\n"
"hkiG9w0BAQsFAAOCAgEAVR9YqbyyqFDQDLHYGmkgJykIrGF1XIpu+ILlaS/V9lZL\r\n"
"ubhzEFnTIZd+50xx+7LSYK05qAvqFyFWhfFQDlnrzuBZ6brJFe+GnY+EgPbk6ZGQ\r\n"
"3BebYhtF8GaV0nxvwuo77x/Py9auJ/GpsMiu/X1+mvoiBOv/2X/qkSsisRcOj/KK\r\n"
"NFtY2PwByVS5uCbMiogziUwthDyC3+6WVwW6LLv3xLfHTjuCvjHIInNzktHCgKQ5\r\n"
"ORAzI4JMPJ+GslWYHb4phowim57iaztXOoJwTdwJx4nLCgdNbOhdjsnvzqvHu7Ur\r\n"
"TkXWStAmzOVyyghqpZXjFaH3pO3JLF+l+/+sKAIuvtd7u+Nxe5AW0wdeRlN8NwdC\r\n"
"jNPElpzVmbUq4JUagEiuTDkHzsxHpFKVK7q4+63SM1N95R1NbdWhscdCb+ZAJzVc\r\n"
"oyi3B43njTOQ5yOf+1CceWxG1bQVs5ZufpsMljq4Ui0/1lvh+wjChP4kqKOJ2qxq\r\n"
"4RgqsahDYVvTH9w7jXbyLeiNdd8XM2w9U/t7y0Ff/9yi0GE44Za4rF2LN9d11TPA\r\n"
"mRGunUHBcnWEvgJBQl9nJEiU0Zsnvgc/ubhPgXRR4Xq37Z0j4r7g1SgEEzwxA57d\r\n"
"emyPxgcYxn/eR44/KJ4EBs+lVDR3veyJm+kXQ99b21/+jh5Xos1AnX5iItreGCc=\r\n"
"-----END CERTIFICATE-----\r\n"
"-----BEGIN CERTIFICATE-----\r\n"
"MIIDQTCCAimgAwIBAgITBmyfz5m/jAo54vB4ikPmljZbyjANBgkqhkiG9w0BAQsF\r\n"
"ADA5MQswCQYDVQQGEwJVUzEPMA0GA1UEChMGQW1hem9uMRkwFwYDVQQDExBBbWF6\r\n"
"b24gUm9vdCBDQSAxMB4XDTE1MDUyNjAwMDAwMFoXDTM4MDExNzAwMDAwMFowOTEL\r\n"
"MAkGA1UEBhMCVVMxDzANBgNVBAoTBkFtYXpvbjEZMBcGA1UEAxMQQW1hem9uIFJv\r\n"
"b3QgQ0EgMTCCASIwDQYJKoZIhvcNAQEBBQADggEPADCCAQoCggEBALJ4gHHKeNXj\r\n"
"ca9HgFB0fW7Y14h29Jlo91ghYPl0hAEvrAIthtOgQ3pOsqTQNroBvo3bSMgHFzZM\r\n"
"9O6II8c+6zf1tRn4SWiw3te5djgdYZ6k/oI2peVKVuRF4fn9tBb6dNqcmzU5L/qw\r\n"
"IFAGbHrQgLKm+a/sRxmPUDgH3KKHOVj4utWp+UhnMJbulHheb4mjUcAwhmahRWa6\r\n"
"VOujw5H5SNz/0egwLX0tdHA114gk957EWW67c4cX8jJGKLhD+rcdqsq08p8kDi1L\r\n"
"93FcXmn/6pUCyziKrlA4b9v7LWIbxcceVOF34GfID5yHI9Y/QCB/IIDEgEw+OyQm\r\n"
"jgSubJrIqg0CAwEAAaNCMEAwDwYDVR0TAQH/BAUwAwEB/zAOBgNVHQ8BAf8EBAMC\r\n"
"AYYwHQYDVR0OBBYEFIQYzIU07LwMlJQuCFmcx7IQTgoIMA0GCSqGSIb3DQEBCwUA\r\n"
"A4IBAQCY8jdaQZChGsV2USggNiMOruYou6r4lK5IpDB/G/wkjUu0yKGX9rbxenDI\r\n"
"U5PMCCjjmCXPI6T53iHTfIUJrU6adTrCC2qJeHZERxhlbI1Bjjt/msv0tadQ1wUs\r\n"
"N+gDS63pYaACbvXy8MWy7Vu33PqUXHeeE6V/Uq2V8viTO96LXFvKWlJbYK8U90vv\r\n"
"o/ufQJVtMVT8QtPHRh8jrdkPSHCa2XV4cdFyQzR1bldZwgJcJmApzyMZFo6IQ6XU\r\n"
"5MsI+yMRQ+hDKXJioaldXgjUkK642M4UwtBV8ob2xJNDd2ZhwLnoQdeXeGADbkpy\r\n"
"rqXRfboQnoZsG4q5WTP468SQvvG5\r\n"
"-----END CERTIFICATE-----\r\n"
"-----BEGIN CERTIFICATE-----\r\n"
"MIIDjjCCAnagAwIBAgIQAzrx5qcRqaC7KGSxHQn65TANBgkqhkiG9w0BAQsFADBh\r\n"
"MQswCQYDVQQGEwJVUzEVMBMGA1UEChMMRGlnaUNlcnQgSW5jMRkwFwYDVQQLExB3\r\n"
"d3cuZGlnaWNlcnQuY29tMSAwHgYDVQQDExdEaWdpQ2VydCBHbG9iYWwgUm9vdCBH\r\n"
"MjAeFw0xMzA4MDExMjAwMDBaFw0zODAxMTUxMjAwMDBaMGExCzAJBgNVBAYTAlVT\r\n"
"MRUwEwYDVQQKEwxEaWdpQ2VydCBJbmMxGTAXBgNVBAsTEHd3dy5kaWdpY2VydC5j\r\n"
"b20xIDAeBgNVBAMTF0RpZ2lDZXJ0IEdsb2JhbCBSb290IEcyMIIBIjANBgkqhkiG\r\n"
"9w0BAQEFAAOCAQ8AMIIBCgKCAQEAuzfNNNx7a8myaJCtSnX/RrohCgiN9RlUyfuI\r\n"
"2/Ou8jqJkTx65qsGGmvPrC3oXgkkRLpimn7Wo6h+4FR1IAWsULecYxpsMNzaHxmx\r\n"
"1x7e/dfgy5SDN67sH0NO3Xss0r0upS/kqbitOtSZpLYl6ZtrAGCSYP9PIUkY92eQ\r\n"
"q2EGnI/yuum06ZIya7XzV+hdG82MHauVBJVJ8zUtluNJbd134/tJS7SsVQepj5Wz\r\n"
"tCO7TG1F8PapspUwtP1MVYwnSlcUfIKdzXOS0xZKBgyMUNGPHgm+F6HmIcr9g+UQ\r\n"
"vIOlCsRnKPZzFBQ9RnbDhxSJITRNrw9FDKZJobq7nMWxM4MphQIDAQABo0IwQDAP\r\n"
"BgNVHRMBAf8EBTADAQH/MA4GA1UdDwEB/wQEAwIBhjAdBgNVHQ4EFgQUTiJUIBiV\r\n"
"5uNu5g/6+rkS7QYXjzkwDQYJKoZIhvcNAQELBQADggEBAGBnKJRvDkhj6zHd6mcY\r\n"
"1Yl9PMWLSn/pvtsrF9+wX3N3KjITOYFnQoQj8kVnNeyIv/iPsGEMNKSuIEyExtv4\r\n"
"NeF22d+mQrvHRAiGfzZ0JFrabA0UWTW98kndth/Jsw1HKj2ZL7tcu7XUIOGZX1NG\r\n"
"Fdtom/DzMNU+MeKNhJ7jitralj41E6Vf8PlwUHBHQRFXGU7Aj64GxJUTFy8bJZ91\r\n"
"8rGOmaFvE7FBcf6IKshPECBV1/MUReXgRPTqh5Uykw7+U0b6LJ3/iyK5S9kJRaTe\r\n"
"pLiaWN0bfVKfjllDiIGknibVb63dDcY3fe0Dkhvld1927jyNxF1WW6LZZm6zNTfl\r\n"
"MrY=\r\n"
"-----END CERTIFICATE-----\r\n"
};
```

## include/utils.h
```c
#ifndef UTILS_H_
#define UTILS_H_

#include <stdbool.h>
#include <stddef.h>
#include <stdint.h>

/* URL parsing functions */
bool parse_url(const char *url, char *host_out, size_t host_len, uint16_t *port_out);
int parse_url_dynamic(const char *url, char *host_out, size_t host_len,
                      char *path_out, size_t path_len,
                      uint16_t *port_out, bool *use_tls_out);

/* JSON parsing functions */
bool extract_json_number(const char *json, const char *key, uint32_t *out_val);
bool extract_json_string(const char *json, const char *key, char *out_buf, size_t out_len);

/* Common utility macros */
#ifndef MIN
#define MIN(a, b) ((a) < (b) ? (a) : (b))
#endif

#ifndef MAX
#define MAX(a, b) ((a) > (b) ? (a) : (b))
#endif

#endif // UTILS_H_
```

## src/mqtt_client.c
```c
/*
 * SPDX-FileCopyrightText: 2025 Khrystyna Olkhovetska for Blynk Technologies Inc.
 * SPDX-License-Identifier: Apache-2.0
 */

#include <zephyr/logging/log.h>
LOG_MODULE_REGISTER(mqtt, LOG_LEVEL_INF);

#include <zephyr/kernel.h>
#include <zephyr/net/socket.h>
#include <zephyr/net/mqtt.h>
#include <zephyr/sys/printk.h>
#include <zephyr/random/random.h>
#include <string.h>
#include <errno.h>
#include <stdio.h>

#include "mqtt_client.h"
#include "root_certificates.h"

/* MQTT buffers */
static uint8_t rx_buffer[APP_MQTT_BUFFER_SIZE];
static uint8_t tx_buffer[APP_MQTT_BUFFER_SIZE];

/* MQTT connection variables */
struct mqtt_client client_ctx;
bool mqtt_connected = false;
struct k_sem mqtt_start = Z_SEM_INITIALIZER(mqtt_start, 0, 1);

/* Network variables */
struct net_mgmt_event_callback l4_mgmt_cb;
const uint32_t L4_EVENT_MASK = (NET_EVENT_L4_CONNECTED | NET_EVENT_L4_DISCONNECTED);

/* Socket handling */
static struct sockaddr_storage broker;
static struct zsock_pollfd fds[1];
static int nfds;

/* MQTT subscription */
static uint8_t devbound_topic[] = "downlink/#";
static struct mqtt_topic subs_topic;
static struct mqtt_subscription_list subs_list;

/* Broker configuration */
char broker_host[128] = CONFIG_CLOUD_BLYNK_SERVER_ADDR;
uint16_t broker_port   = CONFIG_CLOUD_BLYNK_SERVER_PORT;

/* Constants */
#define TLS_SNI_HOSTNAME        CONFIG_CLOUD_BLYNK_SERVER_ADDR
#define APP_SLEEP_MSECS         8000
#define MQTT_CLIENTID           ""

/* TLS configuration */
static const sec_tag_t m_sec_tags[] = { APP_CA_CERT_TAG };

#if defined(CONFIG_DNS_RESOLVER)
static struct zsock_addrinfo hints;
static struct zsock_addrinfo *haddr;
#endif

/* External business logic callbacks - implemented in main.c */
extern void handle_incoming_topic(const char *topic, const char *payload);
extern void on_mqtt_connected(void);
extern void on_mqtt_subscribed(void);
extern void on_mqtt_disconnected(void);

/* Simplified FD handling */
static void prepare_fds(struct mqtt_client *client)
{
    if (client->transport.type == MQTT_TRANSPORT_SECURE) {
        fds[0].fd = client->transport.tls.sock;
    } else {
        fds[0].fd = client->transport.tcp.sock;
    }
    fds[0].events = ZSOCK_POLLIN;
    nfds = 1;
}

static void clear_fds(void)
{
    nfds = 0;
}

static int wait(int timeout)
{
    if (nfds <= 0) {
        return -EINVAL;
    }
    return zsock_poll(fds, nfds, timeout);
}

/* Broker initialization */
static void broker_init(void)
{
    struct sockaddr_in *broker4 = (struct sockaddr_in *)&broker;
    broker4->sin_family = AF_INET;
    broker4->sin_port   = htons(broker_port);

#if defined(CONFIG_DNS_RESOLVER)
    if (haddr != NULL) {
        broker4->sin_addr = ((struct sockaddr_in *)(haddr->ai_addr))->sin_addr;
    } else {
        memset(broker4, 0, sizeof(*broker4));
    }
#else
    if (zsock_inet_pton(AF_INET, broker_host, &broker4->sin_addr) != 1) {
        memset(broker4, 0, sizeof(*broker4));
    }
#endif
}

/* MQTT subscription */
static void subscribe(struct mqtt_client *client)
{
    int err;

    subs_topic.topic.utf8   = devbound_topic;
    subs_topic.topic.size   = strlen(devbound_topic);
    subs_list.list          = &subs_topic;
    subs_list.list_count    = 1U;
    subs_list.message_id    = 1U;

    err = mqtt_subscribe(client, &subs_list);
    if (err) {
        LOG_ERR("Failed to subscribe to %s", devbound_topic);
    }
}

/* Publish functions */
void publish_str(const char *topic, const char *value)
{
    if (!mqtt_connected) {
        return;
    }

    struct mqtt_publish_param param = {
        .message.topic.qos        = MQTT_QOS_1_AT_LEAST_ONCE,
        .message.topic.topic.utf8 = (uint8_t *)topic,
        .message.topic.topic.size = strlen(topic),
        .message.payload.data     = (void *)value,
        .message.payload.len      = strlen(value),
        .message_id               = sys_rand16_get(),
        .dup_flag                 = 0U,
        .retain_flag              = 0U,
    };

    int err = mqtt_publish(&client_ctx, &param);
    if (err) {
        LOG_ERR("Failed to publish to %s (err %d)", topic, err);
    }
}

void terminal_print(const char *msg)
{
    char payload[128];
    snprintf(payload, sizeof(payload), "%s\n", msg);
    publish_str("ds/Terminal", payload);
}

static void mqtt_event_handler(struct mqtt_client *const client,
                              const struct mqtt_evt *evt)
{
    switch (evt->type) {
    case MQTT_EVT_CONNACK:
        if (evt->result) {
            LOG_ERR("MQTT connect failed: %d", evt->result);
            break;
        }

        mqtt_connected = true;
        LOG_INF("MQTT connected");

        /* Call business logic callback */
        on_mqtt_connected();
        break;

    case MQTT_EVT_PUBLISH: {
        int total_len = evt->param.publish.message.payload.len;
        if (total_len >= 512) {
            LOG_ERR("Payload too large: %d bytes", total_len);
            return;
        }

        uint8_t payload_buf[512];
        int read_so_far = 0;
        int rc;

        while (read_so_far < total_len) {
            rc = mqtt_read_publish_payload(client,
                                          payload_buf + read_so_far,
                                          total_len - read_so_far);
            if (rc < 0) {
                LOG_ERR("Failed to read payload: %d", rc);
                return;
            }
            read_so_far += rc;
        }
        payload_buf[total_len] = '\0';

        /* Extract topic */
        char topic_str[128];
        int topic_len = evt->param.publish.message.topic.topic.size;
        if (topic_len >= (int)sizeof(topic_str)) {
            topic_len = sizeof(topic_str) - 1;
        }
        memcpy(topic_str,
               evt->param.publish.message.topic.topic.utf8,
               topic_len);
        topic_str[topic_len] = '\0';

        /* Call business logic handler */
        handle_incoming_topic(topic_str, (char *)payload_buf);

        /* Send ACK */
        struct mqtt_puback_param puback = {
            .message_id = evt->param.publish.message_id
        };
        mqtt_publish_qos1_ack(client, &puback);
        break;
    }

    case MQTT_EVT_DISCONNECT:
        mqtt_connected = false;
        LOG_INF("MQTT disconnected: %d", evt->result);
        clear_fds();

        /* Call business logic callback */
        on_mqtt_disconnected();
        break;

    case MQTT_EVT_SUBACK:
        LOG_INF("Subscribed successfully");

        /* Call business logic callback */
        on_mqtt_subscribed();
        break;

    default:
        LOG_DBG("Unhandled MQTT event: %d", evt->type);
        break;
    }
}

void client_init(struct mqtt_client *client)
{
    static struct mqtt_utf8 password;
    static struct mqtt_utf8 username;
    struct mqtt_sec_config *tls_config;

    mqtt_client_init(client);
    broker_init();

    /* Basic configuration */
    client->broker = &broker;
    client->evt_cb = mqtt_event_handler;
    client->client_id.utf8 = (uint8_t *)MQTT_CLIENTID;
    client->client_id.size = strlen(MQTT_CLIENTID);

    /* Credentials */
    password.utf8 = (uint8_t *)CONFIG_CLOUD_BLYNK_AUTH_TOKEN;
    password.size = strlen(CONFIG_CLOUD_BLYNK_AUTH_TOKEN);
    client->password = &password;

    username.utf8 = (uint8_t *)"device";
    username.size = strlen("device");
    client->user_name = &username;

    client->protocol_version = MQTT_VERSION_3_1_1;

    /* Buffers */
    client->rx_buf      = rx_buffer;
    client->rx_buf_size = sizeof(rx_buffer);
    client->tx_buf      = tx_buffer;
    client->tx_buf_size = sizeof(tx_buffer);

    /* TLS configuration */
    client->transport.type = MQTT_TRANSPORT_SECURE;
    tls_config = &client->transport.tls.config;
    tls_config->peer_verify = TLS_PEER_VERIFY_REQUIRED;
    tls_config->cipher_list = NULL;
    tls_config->sec_tag_list = m_sec_tags;
    tls_config->sec_tag_count = ARRAY_SIZE(m_sec_tags);
    tls_config->hostname = TLS_SNI_HOSTNAME;
}

static void poll_mqtt(void)
{
    int rc;

    while (mqtt_connected) {
        rc = wait(SYS_FOREVER_MS);
        if (rc > 0) {
            if (mqtt_input(&client_ctx) != 0) {
                LOG_WRN("mqtt_input failed, dropping connection");
                mqtt_connected = false;
                break;
            }
        }
    }
}

static int try_to_connect(struct mqtt_client *client)
{
    uint8_t retries = 3U;
    int rc;

    LOG_INF("Connecting to %s:%d", broker_host, broker_port);

    while (retries--) {
        client_init(client);

        rc = mqtt_connect(client);
        if (rc) {
            LOG_ERR("MQTT connect failed (rc=%d, retries left=%d)", rc, retries);
            if ((rc == 4) || (rc == 5)) {
                LOG_ERR("Invalid BLYNK_AUTH_TOKEN");
            }
            k_sleep(K_SECONDS(10));
            continue;
        }

        prepare_fds(client);
        rc = wait(APP_SLEEP_MSECS);
        if (rc < 0) {
            mqtt_abort(client);
            return rc;
        }

        mqtt_input(client);
        if (mqtt_connected) {
            subscribe(client);
            return 0;
        }

        mqtt_abort(client);
        k_sleep(K_SECONDS(10));
    }

    return -EINVAL;
}

/* DNS resolution */
#if defined(CONFIG_DNS_RESOLVER)
static int get_mqtt_broker_addrinfo(void)
{
    int retries = 3;
    int rc = -EINVAL;
    char port_str[6];

    snprintf(port_str, sizeof(port_str), "%u", broker_port);

    while (retries--) {
        hints.ai_family   = AF_INET;
        hints.ai_socktype = SOCK_STREAM;
        hints.ai_protocol = 0;

        rc = zsock_getaddrinfo(broker_host, port_str, &hints, &haddr);
        if (rc == 0) {
            return 0;
        }

        LOG_WRN("DNS resolution failed, retrying...");
        k_sleep(K_SECONDS(1));
    }

    return rc;
}
#endif

/* Main connection function */
void connect_to_cloud_and_publish(void)
{
    int rc = -EINVAL;

#if defined(CONFIG_DNS_RESOLVER)
    rc = get_mqtt_broker_addrinfo();
    if (rc) {
        LOG_ERR("Cannot resolve %s:%u (%d)", broker_host, broker_port, rc);
        return;
    }
#endif

    rc = try_to_connect(&client_ctx);
    if (rc) {
        LOG_ERR("MQTT connect failed: %d", rc);
        return;
    }

    poll_mqtt();
}

/* Abort connection helper */
void abort_mqtt_connection(void)
{
    if (mqtt_connected) {
        mqtt_connected = false;
        mqtt_abort(&client_ctx);
        clear_fds();
    }
}
```

## src/network_manager.c
```c
/*
 * SPDX-FileCopyrightText: 2025 Khrystyna Olkhovetska for Blynk Technologies Inc.
 * SPDX-License-Identifier: Apache-2.0
 */

#include <zephyr/logging/log.h>
LOG_MODULE_REGISTER(net_mgr, LOG_LEVEL_INF);

#include <zephyr/kernel.h>
#include <zephyr/net/net_if.h>
#include <zephyr/net/net_mgmt.h>
#include <zephyr/net/net_event.h>

#include "network_manager.h"
#include "mqtt_client.h"

static bool network_connected = false;

/* Work item for checking network connection */
static struct k_work_delayable check_network_conn;

bool is_network_connected(void)
{
    return network_connected;
}

void network_manager_init(void)
{
#if defined(CONFIG_NET_DHCPV4)
    k_work_init_delayable(&check_network_conn, check_network_connection);
    net_mgmt_init_event_callback(&l4_mgmt_cb,
                                 l4_event_handler,
                                 L4_EVENT_MASK);
    net_mgmt_add_event_callback(&l4_mgmt_cb);
    k_work_schedule(&check_network_conn, K_NO_WAIT);
#else
    /* For static IP, network is ready immediately */
    network_connected = true;
    k_sem_give(&mqtt_start);
#endif
}

#if defined(CONFIG_NET_DHCPV4)
void check_network_connection(struct k_work *work)
{
    struct net_if *iface;

    if (mqtt_connected) {
        return;
    }

    iface = net_if_get_default();
    if (!iface) {
        goto retry;
    }

    if (iface->config.dhcpv4.state == NET_DHCPV4_BOUND) {
        LOG_INF("Network connected - DHCP bound");
        network_connected = true;
        k_sem_give(&mqtt_start);
        return;
    }

retry:
    k_work_reschedule(&check_network_conn, K_SECONDS(3));
}

void l4_event_handler(struct net_mgmt_event_callback *cb,
                     uint32_t mgmt_event,
                     struct net_if *iface)
{
    if ((mgmt_event & L4_EVENT_MASK) != mgmt_event) {
        return;
    }

    if (mgmt_event == NET_EVENT_L4_CONNECTED) {
        LOG_INF("Network L4 connected");
        network_connected = true;
        k_work_reschedule(&check_network_conn, K_SECONDS(3));
        return;
    }

    if (mgmt_event == NET_EVENT_L4_DISCONNECTED) {
        LOG_INF("Network L4 disconnected");
        network_connected = false;
        abort_mqtt_connection();
        k_work_cancel_delayable(&check_network_conn);
        return;
    }
}
#endif
```

## src/utils.c
```c
/*
 * SPDX-FileCopyrightText: 2025 Khrystyna Olkhovetska for Blynk Technologies Inc.
 * SPDX-License-Identifier: Apache-2.0
 */

#include <zephyr/logging/log.h>
LOG_MODULE_REGISTER(utils, LOG_LEVEL_INF);

#include <string.h>
#include <stdint.h>
#include <stdlib.h>
#include <ctype.h>
#include "utils.h"
#include <errno.h>

// Simple URL parser for broker redirection with better validation
bool parse_url(const char *url, char *host_out, size_t host_len, uint16_t *port_out)
{
    if (!url || !host_out || !port_out || host_len == 0) {
        return false;
    }

    const char *p = strstr(url, "://");
    if (!p) {
        LOG_ERR("No protocol in URL");
        return false;
    }
    p += 3;

    // Check if there's anything after protocol
    if (*p == '\0') {
        LOG_ERR("Empty host in URL");
        return false;
    }

    const char *colon = strchr(p, ':');
    const char *slash = strchr(p, '/');

    size_t host_size;
    if (colon && (!slash || colon < slash)) {
        host_size = (size_t)(colon - p);
        if (host_size >= host_len) {
            LOG_ERR("Host too long: %zu chars", host_size);
            return false;
        }
        memcpy(host_out, p, host_size);
        host_out[host_size] = '\0';

        // Parse port with validation
        char *endptr;
        unsigned long port = strtoul(colon + 1, &endptr, 10);
        if (port == 0 || port > 65535) {
            LOG_ERR("Invalid port: %lu", port);
            return false;
        }
        *port_out = (uint16_t)port;
    } else {
        host_size = slash ? (size_t)(slash - p) : strlen(p);
        if (host_size >= host_len) {
            LOG_ERR("Host too long: %zu chars", host_size);
            return false;
        }
        memcpy(host_out, p, host_size);
        host_out[host_size] = '\0';

        // Default port based on protocol
        if (strncmp(url, "mqtts://", 8) == 0) {
            *port_out = 8883;
        } else if (strncmp(url, "mqtt://", 7) == 0) {
            *port_out = 1883;
        } else {
            *port_out = 9443; // Default Blynk port
        }
    }

    // Validate hostname is not empty
    if (strlen(host_out) == 0) {
        LOG_ERR("Empty hostname");
        return false;
    }

    return true;
}

bool extract_json_number(const char *json, const char *key, uint32_t *out_val)
{
    if (!json || !key || !out_val) {
        return false;
    }

    char *p = strstr(json, key);
    if (!p) {
        return false;
    }

    // Find the colon after the key
    p = strchr(p, ':');
    if (!p) {
        return false;
    }
    p++;

    // Skip whitespace and quotes
    while (*p && (isspace((unsigned char)*p) || *p == '"')) {
        p++;
    }

    if (!*p || !isdigit((unsigned char)*p)) {
        return false;
    }

    // Parse the number more carefully
    char *endptr;
    unsigned long val = strtoul(p, &endptr, 10);

    // Validate the parsing
    if (endptr == p) {
        LOG_ERR("No digits found for %s", key);
        return false;
    }

    if (val > UINT32_MAX) {
        LOG_ERR("Value too large for %s: %lu", key, val);
        return false;
    }

    *out_val = (uint32_t)val;
    LOG_DBG("Parsed %s: %u", key, *out_val);
    return true;
}

bool extract_json_string(const char *json, const char *key, char *out_buf, size_t out_len)
{
    if (!json || !key || !out_buf || out_len == 0) {
        return false;
    }

    const char *json_end = json + strlen(json);
    char *p = strstr(json, key);
    if (!p || p >= json_end) {
        LOG_ERR("Key %s not found in JSON", key);
        return false;
    }

    p = strchr(p, ':');
    if (!p || p >= json_end) {
        LOG_ERR("Colon not found after key %s", key);
        return false;
    }

    // Skip whitespace after colon
    p++;
    while (p < json_end && *p && isspace((unsigned char)*p)) {
        p++;
    }

    if (p >= json_end) {
        LOG_ERR("Unexpected end of JSON after key %s", key);
        return false;
    }

    // Find opening quote
    p = strchr(p, '"');
    if (!p || p >= json_end) {
        LOG_ERR("Opening quote not found for key %s", key);
        return false;
    }
    p++;

    // Find closing quote with bounds checking
    char *q = p;
    while (q < json_end && *q && *q != '"') {
        // Handle escaped quotes
        if (*q == '\\' && (q + 1) < json_end && *(q + 1) == '"') {
            q += 2;
        } else {
            q++;
        }
    }

    if (q >= json_end || *q != '"') {
        LOG_ERR("Closing quote not found for key %s", key);
        return false;
    }

    size_t len = (size_t)(q - p);
    if (len >= out_len) {
        LOG_WRN("String too long for buffer, truncating");
        len = out_len - 1;
    }

    memcpy(out_buf, p, len);
    out_buf[len] = '\0';
    LOG_DBG("Parsed %s: %s", key, out_buf);
    return true;
}


int parse_url_dynamic(const char *url, char *host_out, size_t host_len,
                      char *path_out, size_t path_len,
                      uint16_t *port_out, bool *use_tls_out)
{
    if (!url || !host_out || !path_out || !port_out || !use_tls_out) {
        return -EINVAL;
    }

    LOG_INF("Parsing URL: %s", url);

    const char *scheme = strstr(url, "://");
    if (!scheme) {
        LOG_ERR("No scheme found in URL");
        return -EINVAL;
    }

    if (strncmp(url, "https", 5) == 0) {
        *use_tls_out = true;
        *port_out = 443;
    } else if (strncmp(url, "http", 4) == 0) {
        *use_tls_out = false;
        *port_out = 80;
    } else {
        LOG_ERR("Unsupported scheme");
        return -EINVAL;
    }

    scheme += 3; // Skip past "://"

    const char *slash = strchr(scheme, '/');
    if (!slash) {
        slash = scheme + strlen(scheme);
        if (path_len < 2) {
            return -ENAMETOOLONG;
        }
        strncpy(path_out, "/", path_len);
    } else {
        size_t path_size = strlen(slash);
        if (path_size >= path_len) {
            LOG_ERR("Path too long");
            return -ENAMETOOLONG;
        }
        strncpy(path_out, slash, path_len);
    }
    path_out[path_len - 1] = '\0';

    size_t host_size = (size_t)(slash - scheme);
    if (host_size >= host_len) {
        LOG_ERR("Host too long");
        return -ENAMETOOLONG;
    }

    char temp_host[128];
    if (host_size >= sizeof(temp_host)) {
        return -ENAMETOOLONG;
    }

    memcpy(temp_host, scheme, host_size);
    temp_host[host_size] = '\0';

    // Remove port if present
    char *colon = strchr(temp_host, ':');
    if (colon) {
        *colon = '\0';
        char *endptr;
        unsigned long port = strtoul(colon + 1, &endptr, 10);
        if (port == 0 || port > 65535 || *endptr != '\0') {
            LOG_ERR("Invalid port number in URL: %s", colon + 1);
            return -EINVAL;
        }
        *port_out = (uint16_t)port;
    }

    // Normalize any subdomain like fra1.blynk.cloud to blynk.cloud
    const char *suffix = ".blynk.cloud";
    size_t suffix_len = strlen(suffix);
    size_t temp_len = strlen(temp_host);
    if (temp_len > suffix_len &&
        strcmp(temp_host + temp_len - suffix_len, suffix) == 0) {
        strncpy(host_out, "blynk.cloud", host_len);
    } else {
        strncpy(host_out, temp_host, host_len);
    }

    host_out[host_len - 1] = '\0';

    LOG_INF("Parsed - Host: %s, Port: %u, Path: %s, TLS: %s",
            host_out, *port_out, path_out, *use_tls_out ? "yes" : "no");

    return 0;
}
```
